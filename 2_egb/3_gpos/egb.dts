/dts-v1/;
/plugin/;

/ {

    fragment@0 {
        target = <&uart0>; 
        __overlay__ {
            status = "okay";
            egb_uart {
                compatible = "Curt_Torr,egb"; 
                status = "okay";
            };
        };
    };
};